/*@!Encoding:1250*/
includes
{
  #include "Strings.cin"
  #include "TestUnit.cin"
}

variables
{
  
}

void MainTest ()
{
  compareStrings_Test();
}

testcase compareStrings_Test()
{
  assertTrue(compareStrings("abc", "abc"), "compareStrings(\"abc\", \"abc\")");
  assertTrue(compareStrings("ABC", "ABC"), "compareStrings(\"ABC\", \"ABC\")");
  assertFail(compareStrings("ABC", "abc"), "compareStrings(\"ABC\", \"abc\")");
  assertFail(compareStrings("abcx", "abc"), "compareStrings(\"abcx\", \"abc\")");
  assertFail(compareStrings("abc", "abcx"), "compareStrings(\"abc\", \"abcx\")");
  assertFail(compareStrings("abxd", "abcx"), "compareStrings(\"abxd\", \"abcx\")");
}


