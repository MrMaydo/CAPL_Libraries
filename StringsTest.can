/*@!Encoding:1250*/
includes
{
  #include "Strings.cin"
  #include "TestUnit.cin"
}

variables
{
  
}

void MainTest ()
{
  compareStrings_Test();
  isPalindrome_Test();
}

testcase compareStrings_Test(){
  printTestCaseTitle();
  assertTrue(compareStrings("abc", "abc"), "compareStrings(\"abc\", \"abc\")");
  assertTrue(compareStrings("ABC", "ABC"), "compareStrings(\"ABC\", \"ABC\")");
  assertFail(compareStrings("ABC", "abc"), "compareStrings(\"ABC\", \"abc\")");
  assertFail(compareStrings("abcx", "abc"), "compareStrings(\"abcx\", \"abc\")");
  assertFail(compareStrings("abc", "abcx"), "compareStrings(\"abc\", \"abcx\")");
  assertFail(compareStrings("abxd", "abcx"), "compareStrings(\"abxd\", \"abcx\")");
  printTestSummary();
}

testcase isPalindrome_Test(){
  printTestCaseTitle();
  assertTrue(isPalindrome("kotok"), "isPalindrome(\"kotok\")");
  assertTrue(isPalindrome("kottok"), "isPalindrome(\"kottok\")");
  assertFail(isPalindrome("kotkok"), "isPalindrome(\"kotkok\")");
  assertFail(isPalindrome("abcde"), "isPalindrome(\"abcde\")");
  assertFail(isPalindrome("abcdba"), "isPalindrome(\"abcdba\")");
  assertTrue(isPalindrome("101"), "isPalindrome(\"101\")");
  assertFail(isPalindrome(""), "isPalindrome(\"\")");
  printTestSummary();
}
