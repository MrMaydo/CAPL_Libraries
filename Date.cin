/*@!Encoding:1250*/
includes
{
  
}

variables
{
  enum Month
  {
    JANUARY = 0x01,
    FEBRUARY = 0X02,
    MARCH = 0X03,
    APRIL = 0X04,
    MAY = 0X05,
    JUNE = 0X06,
    JULY = 0X07,
    AUGUST = 0X08,
    SEPTEMBER = 0X09,
    OCTOBER = 0X0A,
    NOVEMBER = 0X0B,
    DECEMBER = 0X0C
  }
  enum Day
  {
    MONDAY    = 1,
    TUESDAY   = 2,
    WEDNESDAY = 3,
    THURSDAY  = 4,
    FRIDAY    = 5,
    SATURDAY  = 6,
    SUNDAY    = 7    
  };
}

getCurrentLocalDate(byte date[]){
 long localTime[9];
  getLocalTime(localTime);
  
  date[5] = localTime[0];     //seconds
  date[4] = localTime[1];     //minutes
  date[3] = localTime[2];     //hours
  date[2] = localTime[3];     //day
  date[1] = localTime[4] + 1; //month
  date[0] = localTime[5];     //year 
}
