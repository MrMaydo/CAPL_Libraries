/*@!Encoding:1250*/
includes
{
  
  #include "Character.cin"
  #include "TestUnit.cin"
}

variables
{
  
}


void MainTest ()
{
  isLowerCase_Test();
}

testcase isLowerCase_Test()
{
  printTestCaseTitle();
  assertTrue(isLowerCase('a'), "isLowerCase_Test('a')");
  assertFail(isLowerCase('A'), "isLowerCase_Test('A')");
  assertFail(isLowerCase('1'), "isLowerCase_Test('1')");
  assertFail(isLowerCase(' '), "isLowerCase_Test(' ')");
  assertFail(isLowerCase('}'), "isLowerCase_Test('}')");
}
