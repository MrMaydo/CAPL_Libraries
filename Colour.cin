/*@!Encoding:1250*/
variables
{
  enum Colour
  {
    BLACK,
    WHITE,
    RED,
    GREEN,
    BLUE,
    YELLOW,
    ORANGE,
    GREY,
    BROWN,
    PURPLE,
    LIGHT_RED,
    DARK_RED,
    LIGHT_GREEN,
    DARK_GREEN,
    LIGHT_BLUE,
    DARK_BLUE,
    LIGHT_YELLOW,
    DARK_YELLOW,
    LIGHT_ORANGE,
    GOLD,
    LIGHT_GREY,
    DARK_GREY,
    LIGHT_RED,
    DARK_RED,
    LIGHT_BROWN,
    DARK_BROWN
  };
}

getRGBColour(enum Colour colour, byte RGB[]){
 switch(colour){
  default:
  case BLACK:
    RGB = {0, 0, 0};
    break;
  case WHITE:
    RGB = {255, 255, 255};
    break;
  case LIGHT_RED:
    RGB = {255, 51, 51};
    break;
  case RED:
    RGB = {255, 0, 0};
    break;
  case DARK_RED:
    RGB = {204, 0, 0};
    break;
  case LIGHT_GREEN:
    RGB = {0, 255, 51};
    break;
  case GREEN:
    RGB = {0, 255, 0};
    break;
  case DARK_GREEN:
    RGB = {0, 153, 0};
    break;
  case LIGHT_BLUE:
    RGB = {51, 153, 255};
    break;
  case BLUE:
    RGB = {0, 0, 255};
    break;
  case DARK_BLUE:
    RGB = {0, 0, 204};
    break;
  case LIGHT_YELLOW:
    RGB = {255, 255, 153};
    break;
  case YELLOW:
    RGB = {255, 255, 0};
    break;
  case DARK_YELLOW:
    RGB = {255, 204, 0};
    break;
  case LIGHT_ORANGE:
    RGB = {255, 153, 0};
    break;
  case ORANGE:
    RGB = {255, 102, 0};
    break;
  case GOLD:
    RGB = {255, 204, 51};
    break;
  case LIGHT_GREY:
    RGB = {204, 204, 204};
    break;
  case GREY:
    RGB = {153, 153, 153};
    break;
  case DARK_GREY:
    RGB = {102, 102, 102};
    break;
  case LIGHT_BROWN:
    RGB = {153, 102, 0};
    break;
  case BROWN:
    RGB = {102, 51, 0};
    break;
  case DARK_BROWN:
    RGB = {51, 0, 0};
    break;
  case PURPLE:
    RGB = {102, 0, 153};
    break;
  }
}
setTextColour(enum Colour colour){
  setTextColour(1, colour);
}
setTextColour(dword pageID, enum Colour colour){
  byte RGB[3];
  getColour(colour, RGB);
  WriteTextColor(pageID, RGB[0], RGB[1], RGB[2]);
}
setBackgroungColour(enum Colour colour){
  setBackgroungColour(1, colour);
}
setBackgroungColour(dword pageID, enum Colour colour){
  byte RGB[3];
  getColour(colour, RGB);
  WriteTextBkgColor(pageID, RGB[0], RGB[1], RGB[2]);
}
setColour(enum Colour colour){
  setBackgroungColour(colour);
  setTextColour(colour);
}