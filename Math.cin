/*@!Encoding:1250*/
includes
{
  
}

variables
{
  
}

long min(long x, long y){
 return (x < y) ? x : y; 
}

long max(long x, long y){
 return (x > y) ? x : y; 
}
