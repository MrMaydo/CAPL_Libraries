/*@!Encoding:1250*/
includes
{
  #include "Colour.cin"
}

variables
{
  enum Verdict
  {
    FAILED = 0,
    PASSED = 1
  };
  enum Write_Sink
  {
    SYSTEM = 0,
    CAPL = 1,
    TEST = 4
  };
  enum Write_Severity
  {
    SUCCESS = 0,
    INFORMATION = 1,
    WARNING = 2,
    ERROR = 3
  };
}

assertEquals(int expected, int given, char action[]){
  setVerdict((expected == given), action);
}

assertTrue(int given, char action[]){
  setVerdict((given != 0), action);
}

assertFail(int given, char action[]){
  setVerdict((given == 0), action);
}

setVerdict(int result, char action[]){
  if(result)
    setPassedColour();
  else
    setFailedColour();
  writeLineEx(TEST, INFORMATION,"%s %s", action, ((enum Verdict) result).name());
  setDefaultColour();
}

setDefaultColour(){
  setBackgroungColour(TEST, WHITE);
  setTextColour(TEST, BLACK);
}

setPassedColour(){
  setBackgroungColour(TEST, WHITE);
  setTextColour(TEST, GREEN);
}

setFailedColour(){
  setBackgroungColour(TEST, WHITE);
  setTextColour(TEST, RED);
}

