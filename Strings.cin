/*@!Encoding:1250*/
includes
{
  
}

variables
{
  
}

export byte compareStrings(char string1[], char string2[]){
  int i;
  if(strlen(string1) != strlen(string2))
    return 0;
  for (i = 0; i < strlen(string1); i++){
    if(string1[i] != string2[i])
      return 0;
  }
  return 1;
}
