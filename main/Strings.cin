/*@!Encoding:1250*/
includes
{ 
  #include "Character.cin"
}

variables
{
  
}

byte compareStrings(char string1[], char string2[]){
  int i;
  if(strlen(string1) != strlen(string2))
    return 0;
  for (i = 0; i < strlen(string1); i++){
    if(string1[i] != string2[i])
      return 0;
  }
  return 1;
}

byte isPalindrome(char string[]){
  int len, i;
  len = strlen(string);
  if(len == 0) return 0;
  for(i = 0; i < len/2; i++)
    if(string[i] != string[len-1-i])
      return 0;
  return 1; 
}

byte endsWith(char string[], char ending[]){
  char pattern[1024];
  if(strlen(string) < strlen(ending))
    return 0;
  snprintf(pattern, elCount(pattern),".*%s$", ending);
  return (str_match_regex(string, pattern) == 1);
}

byte startsWith(char string[], char beginning[]){
  char pattern[1024];
  if(strlen(string) < strlen(beginning))
    return 0;
  snprintf(pattern, elCount(pattern),"^%s.*", beginning);
  return (str_match_regex(string, pattern) == 1);
}

upper(char string[]){
  toUpper(string, string, elCount(string));
}

lower(char string[]){
  toLower(string, string, elCount(string));
}

capitalize(char string[]){
  toLower(string, string, elCount(string));
  string[0] = toUpper(string[0]);
}

byte isAlpha(char string[]){
  int i;
  for(i = 0; i < strlen(string); i++)
    if(!isLetter(string[i]))
      return 0;
  return 1;
}

byte isAlnum(char string[]){
  int i;
  for(i = 0; i < strlen(string); i++)
    if(!isLetterOrDigit(string[i]))
      return 0;
  return 1;
}

byte isNumeric(char string[]){
  int i;
  for(i = 0; i < strlen(string); i++)
    if(!isDigit(string[i]))
      return 0;
  return 1;
}

byte isLower(char string[]){
  int i;
  for(i = 0; i < strlen(string); i++)
    if(!isLowerCase(string[i]))
      return 0;
  return 1;
}

byte isUpper(char string[]){
  int i;
  for(i = 0; i < strlen(string); i++)
    if(!isUpperCase(string[i]))
      return 0;
  return 1;
}

swapcase(char string[]){
  int i;
  for(i = 0; i < strlen(string); i++){
    if(!isLetter(string[i])) continue;
    if(isLowerCase(string[i]))
      string[i] = toUpper(string[i]);
    else if(isUpperCase(string[i]))
      string[i] = toLower(string[i]); 
  }
}

zfill(char string[], int numOfZeros){
  int i,j, len;
  if(numOfZeros < 0) return;
  len = strlen(string);
  j = len + numOfZeros;
  while(j >= (elCount(string))){
    numOfZeros--;
    j = len + numOfZeros;
  };
  for(i = 0; i < j; i++){    
    if((j - i) > numOfZeros)
      string[j - 1 - i] = string[len - 1 - i];
    else
      string[j - 1 - i] = '0';
  }
}
