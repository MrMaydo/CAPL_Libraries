/*@!Encoding:1250*/
variables
{
  enum Colour
  {
    BLACK,
    WHITE,
    RED,
    GREEN,
    BLUE,
    YELLOW,
    ORANGE,
    GREY,
    BROWN,
    PURPLE,
    LIGHT_RED,
    DARK_RED,
    LIGHT_GREEN,
    DARK_GREEN,
    LIGHT_BLUE,
    DARK_BLUE,
    LIGHT_YELLOW,
    DARK_YELLOW,
    LIGHT_ORANGE,
    GOLD,
    LIGHT_GREY,
    DARK_GREY,
    LIGHT_BROWN,
    DARK_BROWN
  };
}

getRGBColour(enum Colour colour, byte RGB[]){
 switch(colour){
  default:
  case BLACK:
    setRGBArray(RGB, 0, 0, 0);
    break;
  case WHITE:
    setRGBArray(RGB, 255, 255, 255);
    break;
  case LIGHT_RED:
    setRGBArray(RGB, 255, 51, 51);
    break;
  case RED:
    setRGBArray(RGB, 255, 0, 0);
    break;
  case DARK_RED:
    setRGBArray(RGB, 204, 0, 0);
    break;
  case LIGHT_GREEN:
    setRGBArray(RGB, 0, 255, 51);
    break;
  case GREEN:
    setRGBArray(RGB, 0, 204, 0);
    break;
  case DARK_GREEN:
    setRGBArray(RGB, 0, 153, 0);
    break;
  case LIGHT_BLUE:
    setRGBArray(RGB, 51, 153, 255);
    break;
  case BLUE:
    setRGBArray(RGB, 0, 0, 255);
    break;
  case DARK_BLUE:
    setRGBArray(RGB, 0, 0, 204);
    break;
  case LIGHT_YELLOW:
    setRGBArray(RGB, 255, 255, 153);
    break;
  case YELLOW:
    setRGBArray(RGB, 255, 255, 0);
    break;
  case DARK_YELLOW:
    setRGBArray(RGB, 255, 204, 0);
    break;
  case LIGHT_ORANGE:
    setRGBArray(RGB, 255, 153, 0);
    break;
  case ORANGE:
    setRGBArray(RGB, 255, 102, 0);
    break;
  case GOLD:
    setRGBArray(RGB, 255, 204, 51);
    break;
  case LIGHT_GREY:
    setRGBArray(RGB, 204, 204, 204);
    break;
  case GREY:
    setRGBArray(RGB, 153, 153, 153);
    break;
  case DARK_GREY:
    setRGBArray(RGB, 102, 102, 102);
    break;
  case LIGHT_BROWN:
    setRGBArray(RGB, 153, 102, 0);
    break;
  case BROWN:
    setRGBArray(RGB, 102, 51, 0);
    break;
  case DARK_BROWN:
    setRGBArray(RGB, 51, 0, 0);
    break;
  case PURPLE:
    setRGBArray(RGB, 102, 0, 153);
    break;
  }
}

setRGBArray(byte RGB[], int R, int G, int B){
  RGB[0] = R;
  RGB[1] = G;
  RGB[2] = B;
}

setTextColour(enum Colour colour){
  setTextColour(1, colour);
}
setTextColour(dword pageID, enum Colour colour){
  byte RGB[3];
  getRGBColour(colour, RGB);
  WriteTextColor(pageID, RGB[0], RGB[1], RGB[2]);
}

setBackgroungColour(enum Colour colour){
  setBackgroungColour(1, colour);
}
setBackgroungColour(dword pageID, enum Colour colour){
  byte RGB[3];
  getRGBColour(colour, RGB);
  WriteTextBkgColor(pageID, RGB[0], RGB[1], RGB[2]);
}
