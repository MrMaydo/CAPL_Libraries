/*@!Encoding:1250*/
variables
{
  
}

byte isLowerCase(char ch){
  char strch[1];
  strch[0] = ch;
  return (str_match_regex(strch, "[a-ząćęłńóśźż].*") == 1); // In case of the single characters it works only with [].* // For Strings it should be []*
}

byte isUpperCase(char ch){
  char strch[1];
  strch[0] = ch;
  return (str_match_regex(strch, "[A-ZĄĆĘŁŃÓŚŹŻ].*") == 1); // In case of the single characters it works only with [].*  // For Strings it should be []*
}

byte isLetter(char ch){
  return (isUpperCase(ch) || isLowerCase(ch));
}

byte isDigit(char ch){
  char strch[1];
  strch[0] = ch;
  return (str_match_regex(strch, "[0-9].*") == 1); // In case of the single characters it works only with [].*  // For Strings it should be []*
}

byte isLetterOrDigit(char ch){
  return (isLetter(ch) || isDigit(ch));
}

byte isHexChar(char ch){
  char strch[1];
  strch[0] = ch;
  return (str_match_regex(strch, "[0-9a-fA-F].*") == 1); // In case of the single characters it works only with [].* // For Strings it should be []*
}
