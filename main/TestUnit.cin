/*@!Encoding:1250*/
includes
{
  #include "Colour.cin"
}

variables
{
  int tcPassed;
  int tcFailed;
  int totalPassed;
  int totalFailed;
  enum Verdict
  {
    FAILED = 0,
    PASSED = 1
  };
  enum Write_Sink
  {
    SYSTEM = 0,
    CAPL = 1,
    TEST = 4
  };
  enum Write_Severity
  {
    SUCCESS = 0,
    INFORMATION = 1,
    WARNING = 2,
    ERROR = 3
  };
}

assertEquals(int expected, int given, char action[]){
  setVerdict((expected == given), action);
}

assertEquals(byte expected[], byte given[], char action[]){
  int result, i;
  result = 1;
  
  for(i = 0; i < elCount(expected); i++){
    if(expected[i] != given[i]){
      result = 0;
      break;
    }
  }
  setVerdict(result, action);
}

assertTrue(int given, char action[]){
  setVerdict((given != 0), action);
}

assertFail(int given, char action[]){
  setVerdict((given == 0), action);
}

setVerdict(int result, char action[]){
  if(result){
    setPassedColour();
    tcPassed++;
    totalPassed++;
  }
  else{
    setFailedColour();
    tcFailed++;
    totalFailed++;
  }
  writeLineEx(TEST, INFORMATION,"%s %s", action, ((enum Verdict) result).name());
  setDefaultColour();
  TestWaitForTimeout(10);
}

setDefaultColour(){
  setBackgroungColour(TEST, WHITE);
  setTextColour(TEST, BLACK);
}

setPassedColour(){
  setBackgroungColour(TEST, WHITE);
  setTextColour(TEST, GREEN);
}

setFailedColour(){
  setBackgroungColour(TEST, WHITE);
  setTextColour(TEST, RED);
}

printTestCaseTitle(){
  char title[150];
  testGetCurrentTestCaseTitle(title, elCount(title));
  writeLineEx(TEST, INFORMATION,"%s",title);
}

printTestSummary(){
  int tc_executed;
  tc_executed = tcPassed + tcFailed;
  setPassedColour();
  writeLineEx(TEST, INFORMATION, "Test Cases Passed: %d/%d", tcPassed, tc_executed);
  setFailedColour();
  writeLineEx(TEST, INFORMATION, "Test Cases Failed: %d/%d", tcFailed, tc_executed);
  setDefaultColour();
  
  tcPassed = 0;
  tcFailed = 0;
}

printTotalSummary(){
  int total_executed;
  total_executed = totalPassed + totalFailed;
  setPassedColour();
  writeLineEx(TEST, INFORMATION, "Test Cases Passed in total: %d/%d", totalPassed, total_executed);
  setFailedColour();
  writeLineEx(TEST, INFORMATION, "Test Cases Failed in total: %d/%d", totalFailed, total_executed);
  setDefaultColour();
  
  totalPassed = 0;
  totalFailed = 0;
}

setInitial(){
  tcPassed = 0;
  tcFailed = 0;
 
  totalPassed = 0;
  totalFailed = 0;
}
