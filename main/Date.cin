/*@!Encoding:1250*/
includes
{
  
}

variables
{
  const long PC_baseYear = 1900;
  enum Month
  {
    JANUARY = 0x01,
    FEBRUARY = 0X02,
    MARCH = 0X03,
    APRIL = 0X04,
    MAY = 0X05,
    JUNE = 0X06,
    JULY = 0X07,
    AUGUST = 0X08,
    SEPTEMBER = 0X09,
    OCTOBER = 0X0A,
    NOVEMBER = 0X0B,
    DECEMBER = 0X0C
  }
  enum Day
  {
    MONDAY    = 1,
    TUESDAY   = 2,
    WEDNESDAY = 3,
    THURSDAY  = 4,
    FRIDAY    = 5,
    SATURDAY  = 6,
    SUNDAY    = 7    
  };
}

getCurrentLocalDate(byte date[]){
 long localTime[9];
  getLocalTime(localTime);
  
  date[5] = localTime[0];     //seconds
  date[4] = localTime[1];     //minutes
  date[3] = localTime[2];     //hours
  date[2] = localTime[3];     //day
  date[1] = localTime[4] + 1; //month
  date[0] = localTime[5];     //year 
}

printCurrentLocalDate(){
  byte date[6];
  getCurrentLocalDate(date);
  write("Local Time: %ld-%02ld-%02ld T %02ld:%02ld:%02ld", (date[0] + PC_baseYear), date[1], date[2], date[3], date[4], date[5]);
}

byte isLeapYear(word year){
  return ((year % 4 == 0 && year % 100 != 0) || (year % 400 == 0));
}
decreaseMonth(byte& month, word& year){
  if (month == JANUARY){
    month = DECEMBER;
    year--;
  }
  else
    month--;
}

increaseMonth(byte& month, word& year){
  if (month == DECEMBER){
    month = JANUARY;
    year++;
  }
  else
    month++;
}

byte getNumberOfDaysInMonth(byte month, word year){
  if (month == FEBRUARY && isLeapYear(year) == 1)
    return  29;
  
  if (month == FEBRUARY && isLeapYear(year) == 0)
    return  28;
  
  if (month == APRIL || month == JUNE || month == SEPTEMBER || month == NOVEMBER )
    return 30;
  
  if (month == JANUARY || month == MARCH || month == MAY || month == JULY || month == AUGUST || month == OCTOBER || month == DECEMBER)
    return 31;
  
  return 0;
}

setTimeForward_Days(byte destDate[], byte srcDate[], byte addDays){
  setTimeForward(destDate, srcDate, addDays, 0, 0, 0);
}
setTimeForward_Hours(byte destDate[], byte srcDate[], byte addHours){
  setTimeForward(destDate, srcDate, 0, addHours, 0, 0);
}

setTimeForward_minutes(byte destDate[], byte srcDate[], byte addMinutes){
  setTimeForward(destDate, srcDate, 0, 0, addMinutes, 0);
}
setTimeForward_seconds(byte destDate[], byte srcDate[], byte addSeconds){
  setTimeForward(destDate, srcDate, 0, 0, 0, addSeconds);
}
setTimeForward(byte destDate[], byte srcDate[], byte addDays, byte addHours, byte addMinutes, byte addSeconds){
  word year, srcYear;
  byte month, day, hours, minutes, seconds;
  byte srcMonth, srcDay, srcHours, srcMinutes, srcSeconds;
  byte minutesFromSeconds, hoursFromMinutes, daysFromHours, monthsFromDays;
  byte daysInMonth;
  
  year = srcDate[0] + PC_baseYear;
  month = srcDate[1];
  srcDay = srcDate[2];
  srcHours = srcDate[3];
  srcMinutes = srcDate[4];
  srcSeconds = srcDate[5];
  
  ////////////////////////////////////////
  seconds = (srcSeconds + addSeconds) % 60;
  minutesFromSeconds = (srcSeconds + addSeconds) / 60;
  
  minutes = (srcMinutes + addMinutes + minutesFromSeconds) % 60;
  hoursFromMinutes = (srcMinutes + addMinutes + minutesFromSeconds) / 60;
  
  hours = (srcHours + addHours + hoursFromMinutes) % 24;
  daysFromHours = (srcHours + addHours + hoursFromMinutes) / 24;
  
  daysInMonth = getNumberOfDaysInMonth(srcMonth, srcYear);
  
  day = (srcDay + addDays + daysFromHours) % daysInMonth;
  monthsFromDays = (srcDay + addDays + daysFromHours) / daysInMonth;
  
  if (monthsFromDays == 1)
    increaseMonth(srcMonth, srcYear);
  
  month  = srcMonth;
  year = srcYear;
    
  ////////////////////////////////////////

  year = year - PC_baseYear;
  destDate[5] = seconds;
  destDate[4] = minutes;
  destDate[3] = hours;
  destDate[2] = day; 
  destDate[1] = month;
  destDate[0] = year;
}

setTimeBackward_Days(byte destDate[], byte srcDate[], byte subDays){
  setTimeBackward(destDate, srcDate, subDays, 0, 0, 0);
}
setTimeBackward_Hours(byte destDate[], byte srcDate[], byte subHours){
  setTimeBackward(destDate, srcDate, 0, subHours, 0, 0);
}
setTimeBackward_minutes(byte destDate[], byte srcDate[], byte subMinutes){
  setTimeBackward(destDate, srcDate, 0, 0, subMinutes, 0);
}
setTimeBackward_seconds(byte destDate[], byte srcDate[], byte subSeconds){
  setTimeBackward(destDate, srcDate, 0, 0, 0, subSeconds);
}
setTimeBackward(byte destDate[], byte srcDate[], byte subDays, byte subHours, byte subMinutes, byte subSeconds){
  word year, srcYear;
  byte month, day, hours, minutes, seconds;
  int oneMonthPrior_daysNumber, twoMonthsPrior_daysNumber;
  
  byte srcMonth, srcDay, srcHours, srcMinutes, srcSeconds;
  byte minutesFromSeconds, hoursFromMinutes, daysFromHours;
  ////////////////////////////////////////

  srcYear = srcDate[0] + PC_baseYear;
  srcMonth = srcDate[1];
  srcDay = srcDate[2];
  srcHours = srcDate[3];
  srcMinutes = srcDate[4];
  srcSeconds = srcDate[5];
  
  ////////////////////////////////////////
  seconds = (60 + srcSeconds - subSeconds) % 60;
  minutesFromSeconds = (59 + subSeconds - srcSeconds + 59) / 60;
  
  minutes = (60 + srcMinutes - (subMinutes + minutesFromSeconds)) % 60;
  hoursFromMinutes = (59 + subMinutes - minutesFromSeconds ) / 60;
  
  hours = (24 + srcHours - (subHours + hoursFromMinutes)) % 24;
  daysFromHours = (23 + subHours - srcHours) / 24;
  
  subDays = subDays + daysFromHours;
  month = srcMonth;
  year = srcYear;
  
  ////////////////////////////////////////
  oneMonthPrior_daysNumber = 0; 
  twoMonthsPrior_daysNumber = 0;
  if (srcDay < (1 + subDays) && (month == JANUARY || month == JUNE || month == AUGUST || month == NOVEMBER)){   
    decreaseMonth(month, year);
    oneMonthPrior_daysNumber = getNumberOfDaysInMonth(month, year);
    
    if((oneMonthPrior_daysNumber + srcDay) < (1 + subDays)){
      decreaseMonth(month, year);
      twoMonthsPrior_daysNumber = getNumberOfDaysInMonth(month, year);
    }
  }
  else if (srcDay < (1 + subDays) && (month == FEBRUARY || month == SEPTEMBER)){
    decreaseMonth(month, year);
    oneMonthPrior_daysNumber = getNumberOfDaysInMonth(month, year);
    
    if((oneMonthPrior_daysNumber + srcDay) < (1 + subDays)){
      decreaseMonth(month, year);
      twoMonthsPrior_daysNumber = getNumberOfDaysInMonth(month, year);
    }
  }
  else if (srcDay < (1 + subDays) && (month == MAY || month == JULY  || month == OCTOBER  || month == DECEMBER)){
    decreaseMonth(month, year);
    oneMonthPrior_daysNumber = getNumberOfDaysInMonth(month, year);
    
    if((oneMonthPrior_daysNumber + srcDay) < (1 + subDays)){
      decreaseMonth(month, year);
      twoMonthsPrior_daysNumber = getNumberOfDaysInMonth(month, year);
    }
  }
  
  else if (month == MARCH && srcDay < (1 + subDays)){
    decreaseMonth(month, year);
    oneMonthPrior_daysNumber = getNumberOfDaysInMonth(month, year);
    
    if((oneMonthPrior_daysNumber + srcDay) < (1 + subDays)){
      decreaseMonth(month, year);
      twoMonthsPrior_daysNumber = getNumberOfDaysInMonth(month, year);
    }
  }
  else if (month == APRIL && srcDay < (1 + subDays)){
    decreaseMonth(month, year);
    oneMonthPrior_daysNumber = getNumberOfDaysInMonth(month, year);
    
    if((oneMonthPrior_daysNumber + srcDay) < (1 + subDays)){
      decreaseMonth(month, year);
      twoMonthsPrior_daysNumber = getNumberOfDaysInMonth(month, year);
    }
  }
  
  day = twoMonthsPrior_daysNumber + oneMonthPrior_daysNumber + srcDay - subDays;
  
  ////////////////////////////////////////
  
  year = year - PC_baseYear;
  destDate[5] = seconds;
  destDate[4] = minutes;
  destDate[3] = hours;
  destDate[2] = day; 
  destDate[1] = month;
  destDate[0] = year;
}

