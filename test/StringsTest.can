/*@!Encoding:1250*/
includes
{
  #include "..\main\Strings.cin"
  #include "..\main\TestUnit.cin"
}

variables
{
  
}

void MainTest ()
{
  setInitial();
  compareStrings_Test();
  isPalindrome_Test();
  endsWith_Test();
  startsWith_Test();
  printTotalSummary();
}

testcase compareStrings_Test(){
  printTestCaseTitle();
  assertTrue(compareStrings("abc", "abc"), "compareStrings(\"abc\", \"abc\")");
  assertTrue(compareStrings("ABC", "ABC"), "compareStrings(\"ABC\", \"ABC\")");
  assertFail(compareStrings("ABC", "abc"), "compareStrings(\"ABC\", \"abc\")");
  assertFail(compareStrings("abcx", "abc"), "compareStrings(\"abcx\", \"abc\")");
  assertFail(compareStrings("abc", "abcx"), "compareStrings(\"abc\", \"abcx\")");
  assertFail(compareStrings("abxd", "abcx"), "compareStrings(\"abxd\", \"abcx\")");
  printTestSummary();
}

testcase isPalindrome_Test(){
  printTestCaseTitle();
  assertTrue(isPalindrome("kotok"), "isPalindrome(\"kotok\")");
  assertTrue(isPalindrome("kottok"), "isPalindrome(\"kottok\")");
  assertFail(isPalindrome("kotkok"), "isPalindrome(\"kotkok\")");
  assertFail(isPalindrome("abcde"), "isPalindrome(\"abcde\")");
  assertFail(isPalindrome("abcdba"), "isPalindrome(\"abcdba\")");
  assertTrue(isPalindrome("101"), "isPalindrome(\"101\")");
  assertFail(isPalindrome(""), "isPalindrome(\"\")");
  printTestSummary();
}
testcase endsWith_Test(){
  printTestCaseTitle();
  assertTrue(endsWith("kotek", "ek"), "endsWith(\"kotek\", \"ek\")");
  assertTrue(endsWith("kotek", "kotek"), "endsWith(\"kotek\", \"kotek\")");
  assertTrue(endsWith("pies", "ies"), "endsWith(\"pies\", \"ies\")");
  assertFail(endsWith("kotek", "Ek"), "endsWith(\"kotek\", \"Ek\")");
  assertFail(endsWith("kotek", "etk"), "endsWith(\"kotek\", \"etk\")");
  assertFail(endsWith("kotek", "skotek"), "endsWith(\"kotek\", \"skotek\")");
  printTestSummary();
}
testcase startsWith_Test(){
  printTestCaseTitle();
  assertTrue(startsWith("kotek","kot"), "startsWith(\"kotek\",\"kot\")");
  assertTrue(startsWith("kotek","kotek"), "startsWith(\"kotek\",\"kotek\")");
  assertTrue(startsWith("pies", "pie"), "startsWith(\"pies\", \"pie\")");
  assertFail(startsWith("kotek", "Kot"), "startsWith(\"kotek\", \"Kot\")");
  assertFail(startsWith("kotek", "tok"), "startsWith(\"kotek\", \"tok\")");
  assertFail(startsWith("kotek", "kotekk"), "startsWith(\"kotek\", \"kotekk\")");
  printTestSummary();
}
