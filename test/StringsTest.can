/*@!Encoding:1250*/
includes
{
  #include "..\main\Strings.cin"
  #include "..\main\TestUnit.cin"
}

variables
{
  
}

void MainTest ()
{
  setInitial();
  compareStrings_Test();
  isPalindrome_Test();
  endsWith_Test();
  startsWith_Test();
  upper_Test();
  lower_Test();
  printTotalSummary();
}

testcase compareStrings_Test(){
  printTestCaseTitle();
  assertTrue(compareStrings("abc", "abc"), "compareStrings(\"abc\", \"abc\")");
  assertTrue(compareStrings("ABC", "ABC"), "compareStrings(\"ABC\", \"ABC\")");
  assertFail(compareStrings("ABC", "abc"), "compareStrings(\"ABC\", \"abc\")");
  assertFail(compareStrings("abcx", "abc"), "compareStrings(\"abcx\", \"abc\")");
  assertFail(compareStrings("abc", "abcx"), "compareStrings(\"abc\", \"abcx\")");
  assertFail(compareStrings("abxd", "abcx"), "compareStrings(\"abxd\", \"abcx\")");
  printTestSummary();
}

testcase isPalindrome_Test(){
  printTestCaseTitle();
  assertTrue(isPalindrome("kotok"), "isPalindrome(\"kotok\")");
  assertTrue(isPalindrome("kottok"), "isPalindrome(\"kottok\")");
  assertFail(isPalindrome("kotkok"), "isPalindrome(\"kotkok\")");
  assertFail(isPalindrome("abcde"), "isPalindrome(\"abcde\")");
  assertFail(isPalindrome("abcdba"), "isPalindrome(\"abcdba\")");
  assertTrue(isPalindrome("101"), "isPalindrome(\"101\")");
  assertFail(isPalindrome(""), "isPalindrome(\"\")");
  printTestSummary();
}
testcase endsWith_Test(){
  printTestCaseTitle();
  assertTrue(endsWith("kotek", "ek"), "endsWith(\"kotek\", \"ek\")");
  assertTrue(endsWith("kotek", "kotek"), "endsWith(\"kotek\", \"kotek\")");
  assertTrue(endsWith("pies", "ies"), "endsWith(\"pies\", \"ies\")");
  assertFail(endsWith("kotek", "Ek"), "endsWith(\"kotek\", \"Ek\")");
  assertFail(endsWith("kotek", "etk"), "endsWith(\"kotek\", \"etk\")");
  assertFail(endsWith("kotek", "skotek"), "endsWith(\"kotek\", \"skotek\")");
  printTestSummary();
}
testcase startsWith_Test(){
  printTestCaseTitle();
  assertTrue(startsWith("kotek","kot"), "startsWith(\"kotek\",\"kot\")");
  assertTrue(startsWith("kotek","kotek"), "startsWith(\"kotek\",\"kotek\")");
  assertTrue(startsWith("pies", "pie"), "startsWith(\"pies\", \"pie\")");
  assertFail(startsWith("kotek", "Kot"), "startsWith(\"kotek\", \"Kot\")");
  assertFail(startsWith("kotek", "tok"), "startsWith(\"kotek\", \"tok\")");
  assertFail(startsWith("kotek", "kotekk"), "startsWith(\"kotek\", \"kotekk\")");
  printTestSummary();
}

testcase upper_Test(){
  printTestCaseTitle();
  upper_Test1();
  upper_Test2();
  upper_Test3();
  upper_Test4();
  upper_Test5();
  printTestSummary();
}
upper_Test1(){
  char string[100] = "kotek";
  upper(string);
  assertTrue(compareStrings(string, "KOTEK"), "upper(\"kotek\")");
}
upper_Test2(){
  char string[100] = "koTEk";
  upper(string);
  assertTrue(compareStrings(string, "KOTEK"), "upper(\"koTEk\")");
}
upper_Test3(){
  char string[100] = "KOTEK";
  upper(string);
  assertTrue(compareStrings(string, "KOTEK"), "upper(\"KOTEK\")");
}
upper_Test4(){
  char string[100] = "piesek";
  upper(string);
  assertFail(compareStrings(string, "piesek"), "upper(\"piesek\")");
}
upper_Test5(){
  char string[100] = "piESek";
  upper(string);
  assertFail(compareStrings(string, "piESek"), "upper(\"piESek\")");
}
testcase lower_Test(){
  printTestCaseTitle();
  lower_Test1();
  lower_Test2();
  lower_Test3();
  lower_Test4();
  lower_Test5();
  printTestSummary();
}
lower_Test1(){
  char string[100] = "KOTEK";
  lower(string);
  assertTrue(compareStrings(string, "kotek"), "lower(\"KOTEK\")");
}
lower_Test2(){
  char string[100] = "KOteK";
  lower(string);
  assertTrue(compareStrings(string, "kotek"), "lower(\"KOteK\")");
}
lower_Test3(){
  char string[100] = "kotek";
  lower(string);
  assertTrue(compareStrings(string, "kotek"), "lower(\"kotek\")");
}
lower_Test4(){
  char string[100] = "PIESEK";
  lower(string);
  assertFail(compareStrings(string, "PIESEK"), "lower(\"PIESEK\")");
}
lower_Test5(){
  char string[100] = "PIesEK";
  lower(string);
  assertFail(compareStrings(string, "PIesEK"), "lower(\"PIesEK\")");
}