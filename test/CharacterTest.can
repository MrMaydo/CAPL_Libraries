/*@!Encoding:1250*/
includes
{
  #include "..\main\Character.cin"
  #include "..\main\TestUnit.cin"
}

variables
{
  
}


void MainTest ()
{
  setInitial();
  isLowerCase_Test();
  isUpperCase_Test();
  isDigit_Test();
  isLetter_Test();
  isLetterOrDigit_Test();
  isHexChar_Test();
  printTotalSummary();
}

testcase isLowerCase_Test(){
  printTestCaseTitle();
  assertTrue(isLowerCase('a'), "isLowerCase('a')");
  assertTrue(isLowerCase('ą'), "isLowerCase('ą')");
  assertTrue(isLowerCase('ć'), "isLowerCase('ć')");
  assertTrue(isLowerCase('ę'), "isLowerCase('ę')");
  assertTrue(isLowerCase('ł'), "isLowerCase('ł')");
  assertTrue(isLowerCase('ń'), "isLowerCase('ń')");
  assertTrue(isLowerCase('ó'), "isLowerCase('ó')");
  assertTrue(isLowerCase('ś'), "isLowerCase('ś')");
  assertTrue(isLowerCase('ź'), "isLowerCase('ź')");
  assertTrue(isLowerCase('ż'), "isLowerCase('ż')");
  assertFail(isLowerCase('A'), "isLowerCase('A')");
  assertFail(isLowerCase('Ą'), "isLowerCase('Ą')");
  assertFail(isLowerCase('1'), "isLowerCase('1')");
  assertFail(isLowerCase(' '), "isLowerCase(' ')");
  assertFail(isLowerCase('}'), "isLowerCase('}')");
  assertFail(isLowerCase('\\'), "isLowerCase('\\')");
  printTestSummary();
}

testcase isUpperCase_Test(){
  printTestCaseTitle();
  assertTrue(isUpperCase('A'), "isUpperCase('A')");
  assertTrue(isUpperCase('Ą'), "isUpperCase('Ą')");
  assertTrue(isUpperCase('Ć'), "isUpperCase('Ć')");
  assertTrue(isUpperCase('Ę'), "isUpperCase('Ę')");
  assertTrue(isUpperCase('Ł'), "isUpperCase('Ł')");
  assertTrue(isUpperCase('Ń'), "isUpperCase('Ń')");
  assertTrue(isUpperCase('Ó'), "isUpperCase('Ó')");
  assertTrue(isUpperCase('Ś'), "isUpperCase('Ś')");
  assertTrue(isUpperCase('Ź'), "isUpperCase('Ź')");
  assertTrue(isUpperCase('Ż'), "isUpperCase('Ż')");
  assertFail(isUpperCase('a'), "isUpperCase('a')");
  assertFail(isUpperCase('ą'), "isUpperCase('ą')");
  assertFail(isUpperCase('1'), "isUpperCase('1')");
  assertFail(isUpperCase(' '), "isUpperCase(' ')");
  assertFail(isUpperCase('}'), "isUpperCase('}')");
  assertFail(isUpperCase('\\'), "isUpperCase('\\')");
  printTestSummary();
}

testcase isDigit_Test(){
  printTestCaseTitle();
  assertTrue(isDigit('1'), "isDigit('1')");
  assertTrue(isDigit('9'), "isDigit('9')");
  assertFail(isDigit('a'), "isDigit('a')");
  assertFail(isDigit('A'), "isDigit('A')");
  assertFail(isDigit(' '), "isDigit(' ')");
  assertFail(isDigit('}'), "isDigit('}')");
  assertFail(isDigit('\\'), "isDigit('\\')");
  printTestSummary();
}


testcase isLetter_Test(){
  printTestCaseTitle();
  assertTrue(isLetter('a'), "isLetter('a')");
  assertTrue(isLetter('A'), "isLetter('A')");
  assertTrue(isLetter('ą'), "isLetter('ą')");
  assertTrue(isLetter('Ą'), "isLetter('Ą')");
  assertFail(isLetter('1'), "isLetter('1')");
  assertFail(isLetter(' '), "isLetter(' ')");
  assertFail(isLetter('}'), "isLetter('}')");
  assertFail(isLetter('\\'), "isLetter('\\')");
  printTestSummary();
}

testcase isLetterOrDigit_Test(){
  printTestCaseTitle();
  assertTrue(isLetterOrDigit('a'), "isLetterOrDigit('a')");
  assertTrue(isLetterOrDigit('A'), "isLetterOrDigit('A')");
  assertTrue(isLetterOrDigit('ą'), "isLetterOrDigit('ą')");
  assertTrue(isLetterOrDigit('Ą'), "isLetterOrDigit('ą')");
  assertTrue(isLetterOrDigit('1'), "isLetterOrDigit('1')");
  assertFail(isLetterOrDigit(' '), "isLetterOrDigit(' ')");
  assertFail(isLetterOrDigit('}'), "isLetterOrDigit('}')");
  assertFail(isLetterOrDigit('\\'), "isLetterOrDigit('\\')");
  printTestSummary();
}

testcase isHexChar_Test(){
  printTestCaseTitle();
  assertTrue(isHexChar('0'), "isHexChar('0')");
  assertTrue(isHexChar('9'), "isHexChar('9')");
  assertTrue(isHexChar('a'), "isHexChar('a')");
  assertTrue(isHexChar('A'), "isHexChar('A')");
  assertTrue(isHexChar('f'), "isHexChar('f')");
  assertTrue(isHexChar('F'), "isHexChar('F')");
  assertFail(isHexChar('g'), "isHexChar('g')");
  assertFail(isHexChar('G'), "isHexChar('G')");
  assertFail(isHexChar('ą'), "isHexChar('ą')");
  assertFail(isHexChar('Ą'), "isHexChar('Ą')");
  assertFail(isHexChar(' '), "isHexChar(' ')");
  assertFail(isHexChar('}'), "isHexChar('}')");
  assertFail(isHexChar('\\'), "isHexChar('\\')");
  printTestSummary();
}
