/*@!Encoding:1250*/
includes
{  
  #include "..\main\Math.cin"
  #include "..\main\TestUnit.cin"
}

variables
{
  
}

void MainTest ()
{
  setInitial();
  min_Test();
  max_Test();
  printTotalSummary();
}

testcase min_Test(){
  printTestCaseTitle();
  assertEquals( 0, min(0, 5),  "min(0,5)");
  assertEquals( 0, min(5, 0),  "min(5, 0)");
  assertEquals(-6, min(-6, 1), "min(-6, 1)");
  assertEquals(-6, min(1, -6), "min(1, -6)");
  assertEquals(-5, min(-5, -1), "min(-5, -1)");
  assertEquals(-5, min(-1, -5), "min(-1, -5)");
  printTestSummary();
}
testcase max_Test(){
  printTestCaseTitle();
  assertEquals( 5, max(0, 5), "max(0,5)");
  assertEquals( 5, max(5, 0), "max(5, 0)");
  assertEquals(1, max(-6, 1), "max(-6, 1)");
  assertEquals(1, max(1, -6), "max(1, -6)");
  assertEquals(-1, max(-5, -1), "max(-5, -1)");
  assertEquals(-1, max(-1, -5), "max(-1, -5)");
  printTestSummary();
}
