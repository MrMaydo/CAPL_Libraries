/*@!Encoding:1250*/
includes
{
  #include "Strings.cin"
}

variables
{
  
}

