/*@!Encoding:1250*/
includes
{  
  #include "Math.cin"
  #include "TestUnit.cin"
}

variables
{
  
}

